## config/west.yml
```yaml
manifest:
  remotes:
    - name: zmkfirmware
      url-base: https://github.com/zmkfirmware
    - name: fabian-braun
      url-base: https://github.com/fabian-braun
  projects:
    - name: zmk
      remote: zmkfirmware
      revision: main
      import: app/west.yml
    - name: zmk-nice-oled
      remote: fabian-braun
      revision: main
  self:
    path: config
```
